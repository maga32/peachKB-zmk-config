## config/boards/shields/peachKB/Kconfig.defconfig
```kconfig
if SHIELD_PEACHKB_D || SHIELD_PEACHKB_CR

config ZMK_KEYBOARD_NAME
    default "peachKB"

config ZMK_SPLIT_ROLE_CENTRAL
    default y

endif


if ZMK_DISPLAY

config I2C
    default y

config SSD1306
    default y

choice ZMK_DISPLAY_WORK_QUEUE
    default ZMK_DISPLAY_WORK_QUEUE_DEDICATED
endchoice

endif


if LVGL

config LV_Z_VDB_SIZE
    default 64

config LV_DPI_DEF
    default 148

config LV_Z_BITS_PER_PIXEL
    default 1

choice LV_COLOR_DEPTH
    default LV_COLOR_DEPTH_1
endchoice

endif


if SHIELD_PEACHKB_D || SHIELD_PEACHKB_CR || SHIELD_PEACHKB_R || SHIELD_PEACHKB_L

config ZMK_SPLIT
    default y

endif
```

## config/boards/shields/peachKB/Kconfig.shield
```kconfig
config SHIELD_PEACHKB_D
    def_bool $(shields_list_contains,peachKB_dongle)

config SHIELD_PEACHKB_CR
    def_bool $(shields_list_contains,peachKB_center_right)

config SHIELD_PEACHKB_R
    def_bool $(shields_list_contains,peachKB_right)

config SHIELD_PEACHKB_L
    def_bool $(shields_list_contains,peachKB_left)
```
